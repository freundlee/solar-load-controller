## esp32_dashboard/sdkconfig.defaults
```kconfig
# Target
CONFIG_IDF_TARGET="esp32p4"

# CPU & Performance
CONFIG_ESP_DEFAULT_CPU_FREQ_MHZ_360=y

# PSRAM (32MB AP Gen4)
CONFIG_SPIRAM=y
CONFIG_SPIRAM_MODE_HEX=y
CONFIG_SPIRAM_SPEED_200M=y
CONFIG_SPIRAM_BOOT_INIT=y
CONFIG_SPIRAM_ALLOW_STACK_EXTERNAL_MEMORY=y
CONFIG_SPIRAM_TRY_ALLOCATE_WIFI_LWIP=y

# Flash (16MB Boya QIO)
CONFIG_ESPTOOLPY_FLASHSIZE_16MB=y
CONFIG_ESPTOOLPY_FLASHMODE_QIO=y
CONFIG_ESPTOOLPY_FLASHFREQ_80M=y

# Partition table
CONFIG_PARTITION_TABLE_CUSTOM=y
CONFIG_PARTITION_TABLE_CUSTOM_FILENAME="partitions.csv"

# LVGL
CONFIG_LV_MEM_CUSTOM=y
CONFIG_LV_MEMCPY_MEMSET_STD=y
CONFIG_LV_USE_PERF_MONITOR=y
CONFIG_LV_COLOR_DEPTH_16=y

# Display - MIPI DSI
CONFIG_BSP_LCD_TYPE_MIPI_DSI=y

# FreeRTOS
CONFIG_FREERTOS_HZ=1000
CONFIG_FREERTOS_TIMER_TASK_STACK_DEPTH=4096

# HTTP Client
CONFIG_ESP_HTTP_CLIENT_ENABLE_HTTPS=n

# Networking
CONFIG_LWIP_MAX_SOCKETS=16
CONFIG_LWIP_SO_RCVBUF=y

# ESP-Hosted (Wi-Fi via ESP32-C6 SDIO)
CONFIG_ESP_WIFI_REMOTE_ENABLED=y

# SPIFFS
CONFIG_SPIFFS_MAX_PARTITIONS=2

# Log level
CONFIG_LOG_DEFAULT_LEVEL_INFO=y
CONFIG_LOG_MAXIMUM_LEVEL_DEBUG=y

# Stack sizes
CONFIG_ESP_MAIN_TASK_STACK_SIZE=8192
CONFIG_ESP_SYSTEM_EVENT_TASK_STACK_SIZE=4096

# Watchdog
CONFIG_ESP_TASK_WDT_TIMEOUT_S=30
```
